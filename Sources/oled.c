
#include "derivative.h"
#include "oled.h"

#define LCD_SCL PORTE_PE7   // 时钟定义
#define LCD_SDA PORTE_PE6   // 数据口D1
#define LCD_RST PORTE_PE5   // 复位低电平
#define LCD_DC  PORTE_PE4   // 偏置电压, 0选择写指令

#define WIDTH   128
#define HEIGHT  64   


/********************************************
*   byte F6x8[]
    标准ASCII字符
*********************************************/
const byte F6x8[][6] =
{
    { 0x00, 0x00, 0x00, 0x00, 0x00, 0x00 },   // sp
    { 0x00, 0x00, 0x00, 0x2f, 0x00, 0x00 },   // !
    { 0x00, 0x00, 0x07, 0x00, 0x07, 0x00 },   // "
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    { 0x14, 0x14, 0x14, 0x14, 0x14, 0x14 }    // horiz lines
};

const byte F14x16_Idx[] = 
{
	"北京龙丘邱科技开发板智能车首选液晶室温度按键次电压"
};
const byte F14x16[] = {  
0x20,0x20,0x20,0x20,0xFF,0x00,0x00,0x00,0xFF,0x40,0x20,0x30,0x18,0x10,
0x30,0x18,0x08,0x04,0x7F,0x00,0x00,0x00,0x3F,0x40,0x40,0x40,0x40,0x78,//北0
0x04,0x04,0xE4,0x24,0x24,0x25,0x26,0x24,0x24,0x24,0xE4,0x06,0x04,0x00,
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0x18,0x27,0x20,0x20,0x20,0x20,0x20,0x3F,0x20,0x21,0x2E,0x24,0x20,0x20,//压24  
};

//======================================================
// 128X64I液晶底层驱动[8X16]字体库
// 设计者: powerint
// 描  述: [8X16]西文字符的字模数据 (纵向取模,字节倒序)
// !"#$%&'()*+,-./0123456789:;<=>?@ABCDEFGHIJKLMNOPQRSTUVWXYZ[\]^_`abcdefghijklmnopqrstuvwxyz{|}~
//======================================================
const byte F8x16[]=
{
	0x00,0x00,0x00,0x00,0x00,0x00,0x00,0x00,0x00,0x00,0x00,0x00,0x00,0x00,0x00,0x00,// 0
  0x00,0x00,0x00,0xF8,0x00,0x00,0x00,0x00,0x00,0x00,0x00,0x33,0x30,0x00,0x00,0x00,//!1
  0x00,0x10,0x0C,0x06,0x10,0x0C,0x06,0x00,0x00,0x00,0x00,0x00,0x00,0x00,0x00,0x00,//"2
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  0x00,0x06,0x01,0x01,0x02,0x02,0x04,0x04,0x00,0x00,0x00,0x00,0x00,0x00,0x00,0x00,//~94

};

void writeCmd(byte cmd){
  int cycle;     // uchar is not declared
  LCD_DC = 0;
  LCD_SCL = 0;
  for(cycle=0; cycle < 8; ++cycle){
    if(cmd & 0X80)
      LCD_SDA = 1;
    else
      LCD_SDA = 0;
    
    LCD_SCL = 1;
    asm("nop");
    asm("nop");
    LCD_SCL = 0;
    cmd <<= 1;  
  }
}

void initLCD(void){
  DDRE = 0XFF;
  LCD_SCL = 1;
  LCD_RST = 0;
  asm("nop");
  asm("nop");
  LCD_RST = 1;
  writeCmd(0XA0);
  writeCmd(0XC0);
  writeCmd(0X8D);
  writeCmd(0X14);
  writeCmd(0XAF);
    
}

/********************************************
*  clsLCD()
*  清屏
*********************************************/
void clsLCD(){
  byte x, y;
  for(y=0; y < 8; ++y){
    writeCmd(0xb0 + y);
    writeCmd(0x01);
    writeCmd(0x10);
    for(x=0; x < WIDTH; ++x)
      writeData(0);
  }
}

void writeData(byte data){
  int cycle;
  LCD_DC = 1;
  LCD_SCL = 0;
  for(cycle=0; cycle < 8; ++cycle){
    if(data & 0X80)
      LCD_SDA = 1;
    else
      LCD_SDA = 0;
    
    LCD_SCL = 1;
    asm("nop");
    asm("nop");
    LCD_SCL = 0;
    data <<= 1;
  }

}

void lcdSetPos(byte x, byte y){
  writeCmd(0xb0 + y);
  writeCmd(((x & 0xf0) >> 4) | 0x10);
  writeCmd((x & 0x0f) | 0x01);
}

void fillLCD(byte data){
  byte x, y;
  for(y=0; y < 8; ++y){
    writeCmd(0XB0 + y);
    writeCmd(0X01);
    writeCmd(0X10);
    for(x=0; x < WIDTH; ++x)
       writeData(data);  
  }  
}

/********************************************
*  lcdP6x8Str(byte x, byte y, byte ch[])
*  写入一组标准ASCII字符串
*  显示位置为:(x, y), y为页范围 0 ~7
*********************************************/
void lcdP6x8Str(byte x, byte y, byte ch[]){
  byte c = 0, i = 0, j = 0;
  while(ch[j] != '\0'){
    c = ch[j] - 32;
    if(x > 126){
      x = 0;
      y ++;    
    }
    lcdSetPos(x, y);
    for(i=0; i < 6; ++i){
      writeData(F6x8[c][i]);    
    }
    x += 6;
    j++;
  }
}


/********************************************
*  lcdP8x16Str(byte x, byte y, byte ch[])
*  写入一组标准ASCII字符串
*  显示位置为:(x, y), y为页范围 0 ~7
*********************************************/
void lcdP8x16Str(byte x, byte y, byte ch[]){
  byte c = 0, i = 0, j = 0;
  while(ch[j] != '\0'){
    c = ch[j] - 32;
    if(x > 120){
      x = 0;
      y ++;    
    }
    lcdSetPos(x, y);
    for(i=0; i < 8; ++i){
      writeData(F8x16[c*16 + i]);    
    }
    
    lcdSetPos(x, y + 1);
    for(i=0; i < 8; ++i){
      writeData(F8x16[c*16 + i + 8]);    
    }
    x += 8;
    j++;
  }
}


/********************************************
*  lcdP14x16Str(byte x, byte y, byte ch[])
*  输出汉字字符
*  
*********************************************/
void lcdP14x16Str(byte x, byte y, byte ch[]){
  byte wm = 0, i = 0;
  word addr = 1;
  while(ch[i] != '\0'){
  
    wm = 0;
    addr = 1;
    while(F14x16_Idx[wm] > 127){
      if(F14x16_Idx[wm] == ch[i]){
        if(F14x16_Idx[wm + 1] == ch[i + 1]){
          addr = wm *14;
          break;        
        }     
      }    
    }
    if(x > 118){
      x = 0;
      y++;
    }
    lcdSetPos(x, y);
    if(addr != 1){
      lcdSetPos(x, y);
      for(wm=0; wm < 14;++wm){
        writeData(F14x16[addr]);
        addr += 1;      
      }
      lcdSetPos(x, y + 1);
      for(wm=0; wm < 14; ++wm){
        writeData(F14x16[addr]);
        addr += 1;
      }
    } else {
      i += 1;
      lcdSetPos(x, y);
      for(wm=0; wm < 16; ++wm){
        writeData(0);
      }
      lcdSetPos(x, y + 1);
      for(wm=0; wm < 16; ++wm){
        writeData(0);
      }    
    }
    x += 14;
    i += 2; 
  }
}

/********************************************
*  lcdPrint(byte x, byte y, byte ch[])
*  输出汉字和字符混合字符串
*  
*********************************************/

void lcdPrint(byte x, byte y, byte ch[]){
  byte ch2[3];
  byte i = 0;
  while(ch[i] != '\0'){
    if(ch[i] > 127){
      ch2[0] = ch[i];
      ch2[1] = ch[i + 1];
      ch2[2] = '\0';             // 两字节
      lcdP14x16Str(x, y, ch2);   // 显示汉字
      x += 14;
      i += 2;
    
    } else {
      ch2[0] = ch[i];
      ch2[1] = '\0';            // 一字节
      lcdP8x16Str(x, y, ch2);   // 显示字母
      x += 8;
      i += 1;    
    } 
  }
}












